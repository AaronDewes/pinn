## buildroot/package/compositor/Config.in
```kconfig
config BR2_PACKAGE_COMPOSITOR
        bool "qwindow-compositor"
    select BR2_PACKAGE_QT5
    select BR2_PACKAGE_QT5_QTPNG
    select BR2_PACKAGE_QT5_GFX_LINUXFB
    select BR2_PACKAGE_QT5_GFX_VNC
    select BR2_PACKAGE_QT5_QTFREETYPE
    select BR2_PACKAGE_QT5_SYSTEMZLIB
    select BR2_PACKAGE_QT5_MOUSE_PC
    select BR2_PACKAGE_QT5_KEYBOARD_TTY
    select BR2_PACKAGE_QJSON
    select BR2_PACKAGE_WPA_SUPPLICANT
        help
          Custom compositor, based on qwindow-compositor
```

## buildroot/package/endorphin/Config.in
```kconfig
config BR2_PACKAGE_ENDORPHIN
        bool "endorphin"
    select BR2_PACKAGE_QT5
    select BR2_PACKAGE_QT5_WEBKIT
    select BR2_PACKAGE_QT5_GIF
    select BR2_PACKAGE_QT5_QTJPEG
    select BR2_PACKAGE_QT5_QTPNG
        help
          Endorphin web browser
```
